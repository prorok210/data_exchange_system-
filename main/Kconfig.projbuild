## main/Kconfig.projbuild
```kconfig
menu "WiFi Configuration"
    config WIFI_SSID
        string "WiFi SSID"
        default "MyAccessPoint"
        help
            WiFi SSID (network name) to connect to

    config WIFI_PASSWORD
        string "WiFi Password"
        default "password123"
        help
            WiFi password

    config MAXIMUM_RETRY
        int "Maximum connection retries"
        default 5
        help
            Maximum number of connection attempts
endmenu

menu "UART Configuration"
    config UART_BAUD_RATE
        int "UART Baud Rate"
        default 115200
        help
            UART communication speed
endmenu
```

## sdkconfig.defaults
```kconfig
CONFIG_IDF_TARGET="esp8266"
CONFIG_ESPTOOLPY_FLASHSIZE_2MB=y
CONFIG_ESPTOOLPY_BAUD_921600B=y
CONFIG_ESP_MAIN_TASK_STACK_SIZE=4096
CONFIG_FREERTOS_MAX_PRIORITIES=15
```
